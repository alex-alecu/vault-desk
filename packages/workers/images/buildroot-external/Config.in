## packages/workers/images/buildroot-external/package/vault-agent-init/Config.in
```kconfig
config BR2_PACKAGE_VAULT_AGENT_INIT
	bool "vault-agent-init"
	depends on BR2_PACKAGE_PYTHON3
	help
	  Single-purpose M3 typed code-agent entrypoint.
```

## packages/workers/images/buildroot-external/package/vault-node-runtime/Config.in
```kconfig
config BR2_PACKAGE_VAULT_NODE_RUNTIME
	bool "vault-node-runtime"
	depends on BR2_aarch64
	help
	  Fixed Node.js runtime without npm or Corepack for the M3 agent guest.
```

## packages/workers/images/buildroot-external/package/vault-probe-init/Config.in
```kconfig
config BR2_PACKAGE_VAULT_PROBE_INIT
	bool "vault-probe-init"
	help
	  Single-purpose M1 guest entrypoint for the bounded worker protocol probe.
```
